## boards/arm/dashboard/Kconfig.board
```kconfig
# Copyright (c) HyTech Racing
# SPDX-License-Identifier: Apache-2.0

config BOARD_DASHBOARD
	bool "STM32H723VE Dashboard"
	select CPU_CORTEX_M7
	select SOC_STM32H723VE
```

## boards/arm/dashboard/Kconfig.dashboard
```kconfig
# Copyright (c) HyTech Racing
# SPDX-License-Identifier: Apache-2.0

config BOARD_DASHBOARD
	select SOC_STM32H723XX
```

## boards/arm/dashboard/board.yml
```yaml
# Copyright (c) 2024 Nordic Semiconductor ASA
# SPDX-License-Identifier: Apache-2.0

board:
  name: dashboard
  full_name: HyTech Hashboard
  vendor: st
  socs:
    - name: stm32h723xx
```

## boards/arm/dashboard/dashboard_defconfig
```kconfig
# Copyright (c) HyTech Racing
# SPDX-License-Identifier: Apache-2.0

# Disable MPU
CONFIG_ARM_MPU=n
# Disable HW stack protection
CONFIG_HW_STACK_PROTECTION=y

# Enable UART console on all configurations for convenience. This is usually
# done at board level upstream so that all samples output printed messages to
# the configured #zephyr,console. In production boards, this may be enabled at
# application level or in a debug configuration overlay.

# Enable UART
CONFIG_SERIAL=y
# Console
CONFIG_CONSOLE=y
CONFIG_UART_CONSOLE=y

# Enable GPIO #TODO: Check
CONFIG_GPIO=y

CONFIG_NUM_IRQS=100

CONFIG_BOARD_DASHBOARD=y
```

## boards/vendor/custom_plank/Kconfig.HT09_Dash
```kconfig
# Copyright (c) HyTech
# SPDX-License-Identifier: Apache-2.0

config Dashboard
	select SOC_STM32H723XX
```

## boards/vendor/dashboard/Kconfig.HT09_Dash
```kconfig
# Copyright (c) HyTech Racing
# SPDX-License-Identifier: Apache-2.0

config Dashboard
	select SOC_STM32H723XX
```
